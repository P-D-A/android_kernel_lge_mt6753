/* Copyright (c) 2014, The Linux Foundation. All rights reserved.
 *
 * This program is free software; you can redistribute it and/or modify
 * it under the terms of the GNU General Public License version 2 and
 * only version 2 as published by the Free Software Foundation.
 *
 * This program is distributed in the hope that it will be useful,
 * but WITHOUT ANY WARRANTY; without even the implied warranty of
 * MERCHANTABILITY or FITNESS FOR A PARTICULAR PURPOSE.  See the
 * GNU General Public License for more details.
 */

&i2c1 {
	lg4894@28 {
		status = "okay";
		compatible = "lge,lg4894";
		reg = <0x28>;
		interrupt-parent = <&eintc>;
		interrupts = <10 0x02>;
		debounce = <10 0>;
		irqflags = <0x2008>;

		//pinctrl-names = "pmx_ts_active","pmx_ts_suspend";
		//pinctrl-0 = <&ts_int_active>;
		//pinctrl-1 = <&ts_int_suspend>;

		reset-gpio = <&pio 62 0x00>;
		irq-gpio = <&eintc 10 0x2008>;

		/* Caps */
		max_x = <720>;
		max_y = <1280>;
		max_pressure = <0xff>;
		max_width = <15>;
		max_orientation = <1>;
		max_id = <10>;

		/* role */
		hw_reset_delay = <90>;
		sw_reset_delay = <90>;
		use_lpwg = <1>;
		use_lpwg_test = <1>;

		/* firmware */
		use_upgrade = <0>;
		//fw_image = "touch/ph1/L0L53P1_1_04.img",	/* LG4946 */
		//		   "touch/ph1/H1_LG4945_0.01.img";	/* LG4945 */

		//panel_spec = "touch/ph1/h1_limit.txt";
		//panel_spec_mfts = "touch/ph1/h1_limit_mfts.txt";
	};
};