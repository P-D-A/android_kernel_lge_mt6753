## drivers/input/sensor/Kconfig
```kconfig
#
# Input misc drivers configuration
#
menuconfig INPUT_SENSOR_TOUCH_KEY
	bool "touch key devices"
	help
	  Say Y here, and a list of touch key input drivers will be displayed.
	  Everything that didn't fit into the other categories is here. This option
	  doesn't affect the kernel.

	  If unsure, say Y.

config SENSOR_TOUCH_KEY_ATMF04
       bool "ATMF04 support"
       depends on I2C
       help
         Support ATMF04 as an input device.

config LGE_K7_CAP
       bool "Capsensor device"
       help
         Support Capsensor as K7 Model.
```

## drivers/misc/mediatek/accelerometer/bmi160_acc/Kconfig
```kconfig
config MTK_BMI160A
	bool "MTK_BMI160A for MediaTek package"
	default n
	help
	  It support different accelerometer sensor.
          If this option is set,
	  it will support
          MTK_BMI160 Accelerometer.
```

## drivers/misc/mediatek/accelerometer/lsm6ds3-acc/Kconfig
```kconfig
config MTK_LSM6DS3A
	bool "MTK_LSM6DS3A for MediaTek package"
	default n
	help
	  It support different accelerometer sensor.
          If this option is set,
	  it will support
          MTK_LSM6DS3 Accelerometer.
```

## drivers/misc/mediatek/base/power/Kconfig
```kconfig
config MTK_CLKMGR
	bool "Mediatek proprietary clock management"
	default n
	---help---
	  Mediatek proprietary clock management is used to operate
          the clocks. The clocks are composed of CG, MUX, PLL,
          non-MTCMOS. The operations of clocks are enabling,
          disabling, and querying status. If this config is not set,
          system will use COMMON_CLK instead.

config SODI_OFF
	bool "Disable SODI"
	depends on (ARCH_MT6735 || ARCH_MT6735M || ARCH_MT6753)
	default n
	help
	  Select if you want to disable Screen ON DeepIdle (SODI).
```

## drivers/misc/mediatek/broadcast/Kconfig
```kconfig
# LGE Broadcast Device Driver Support

menu "LGE Broadcast Device Support"


if(ARCH_MTK_PROJECT = "muse6753_m4_m")
config LGE_BROADCAST_SBTVD_LATIN
	bool "1Seg Broadcast service"
	depends on (ARCH_MT6753)
	default y
	help
	  Select this if you want to use Japanese 1Seg mobile broadcast service

config LGE_BROADCAST_BRAZIL_FREQ
	bool "1Seg Broadcast service"
	depends on (ARCH_MT6753)
	default y
	help
	  Select this if you want to use Japanese 1Seg mobile broadcast service
endif

if(ARCH_MTK_PROJECT = "muse6753_k7_m")
config LGE_BROADCAST_TDMB
	bool "LGE broadcast TDMB device Driver"
	depends on (ARCH_MT6753)
	default y
	help
	  Select this if you want to use TDMB broadcast service
endif

source "drivers/misc/mediatek/broadcast/oneseg/Kconfig"
source "drivers/misc/mediatek/broadcast/tdmb/Kconfig"
endmenu
```

## drivers/misc/mediatek/chargepump/Kconfig
```kconfig
config	CUSTOM_KERNEL_CHARGEPUMP
	bool "chargepump Support"
	default n
	help
	  This feature Option is used for projects which using exteranl backlight driver
	  if you want to  external backlight driver, please turn on this feature first,
	  then LED driver call external backlight driver API.
	  Also this feature related to flashlight and DSV driver.

config LEDS_LM3632
         bool "LM3632 LED"
        default n

config LEDS_LM3639
        bool "LM3639 Support"
        default n

config LEDS_RT8542
        bool "RT8542 Support"
        default n

config LEDS_RT4832
        bool "RT4832 Support"
        default n
	
config DSV_SM5107
        bool "SM5107 Support"
        default n
```

## drivers/misc/mediatek/gyroscope/bmi160_gyro/Kconfig
```kconfig
config MTK_BMI160G
        bool "BMI160G for MediaTek package"
        default n
	help
        It support different gyroscope sensor.
        If this option is set,
	  	it will support
         MTK_BMI160 gyroscope.
```

## drivers/misc/mediatek/gyroscope/lsm6ds3gy-new/Kconfig
```kconfig
config MTK_LSM6DS3G
        bool "LSM6DS3G for MediaTek package"
        default n
	help
        It support different gyroscope sensor.
        If this option is set,
	  	it will support
         MTK_LSM6DS3 gyroscope.
```

## drivers/misc/mediatek/hallic/Kconfig
```kconfig
config MTK_HALLIC
	bool "HALLIC for MediaTek package"
	default n
	help
	  It support hallic sensor.

config CORNER_QUICK_COVER
	bool "CORNER_QUICK_COVER for LGE package"
	default n
	help
	  It support corner case.
	  
source "drivers/misc/mediatek/hallic/bu52033nvx/Kconfig"
```

## drivers/misc/mediatek/hallic/bu52033nvx/Kconfig
```kconfig
config BU52033NVX
	bool "BU52033NVX Hall IC for MediaTek package"
	default n
	help
	  It support different hallic sensor.
          If this option is set,
	  it will support
          BU52033NVX Hall IC.
```

## drivers/misc/mediatek/magnetometer/bmm050/Kconfig
```kconfig
config MTK_BMM050
	bool "BMM050 for MediaTek package"
	default n
	help
	  It support different magnetometer sensor.
          If this option is set,
	  it will support
          BMM050 magnetometer in BMC150.
```

## drivers/misc/mediatek/magnetometer/k303b/Kconfig
```kconfig
config MTK_K303B
	bool "K303B for MediaTek package"
	default n
	help
	  It support different magnetometer sensor.
          If this option is set,
	  it will support
          K303B magnetometer.
```

## drivers/misc/mediatek/rtc/Kconfig
```kconfig
# RTC Related
config MTK_RTC
	bool "MediaTek Real Time Clock Support"
	default n
	---help---
	  MediaTek RTC driver

config RTC_INTF_SECCLK
        bool "Android secure clock driver"
        depends on MTK_RTC
        default n
        help
         Driver for supporting Android secure clock
```
